; *************************************************************
; *** Scatter-Loading Description File generated by uVision ***
; *************************************************************
LR_ROM1 0x00000000 0x01100000  {
  ER_ROM1 0x00000000 0x01100000  {  ; load address = execution address
   .ANY (+RO)
  }
}
